## buildroot-master_from-github/package/userApps/Config.in
```kconfig
source "package/userApps/greeting/Config.in"
source "package/userApps/greeting2/Config.in"
```

## buildroot-master_from-github/package/userApps/greeting2/Config.in
```kconfig
config BR2_PACKAGE_GREETING2
	bool "greeting2"
	help
  	  simple hello program from Buildroot.
```

## buildroot/package/userApps/greeting/Config.in
```kconfig
config BR2_PACKAGE_GREETING
	bool "greeting"
	help
  	  simple hello program from Buildroot.
```

## buildroot/package/userdefinedapps/gpio_web/Config.in
```kconfig
config BR2_PACKAGE_GPIO_WEB
    bool "gpio-web (Lighttpd CGI + libgpiod)"
    select BR2_PACKAGE_LIBGPIOD
    select BR2_PACKAGE_LIGHTTPD
    help
      Installs CGI handlers, index.html, and lighttpd.conf to /www and /etc/lighttpd.
```
